#include <Servo.h>

Servo magnet;

// defines pins numbers
const int stepPinA = 6; // Yellow
const int dirPinA = 7;  // Green
const int stepPinB = 12;
const int dirPinB = 10;
const int magIn = 11;
const int squareMult = 1625; // *2
const int diagMult = 2;
const int gameLen = 1085;

int magLow = 85;
int magHigh = 170;
//2055;
//1265

//#define INPUT_SIZE 14;

void setup() {
  // Sets the two pins as Outputs
//  pinMode(9, OUTPUT);
  pinMode(stepPinA, OUTPUT);
  pinMode(dirPinA, OUTPUT);
  pinMode(stepPinB, OUTPUT);
  pinMode(dirPinB, OUTPUT);

//  Serial.begin(9600);

  magnet.attach(magIn);
  magnet.write(magLow);


}
//{5,0,0,0,0,0,5,0,0,0,0,0,-5,0,0};

// 11 squares = 44.7cm (in x +ve) like 0.1cm from (0,0)
// 9 squares = 36.6cm (in y +ve) 1.3cm away from (0,0)



//{0,0,9,0,0};
//{-11,-9,0,0,0};
//{0,0,-9,0,0};
//{9,0,0,0,0,0,9,0,0,0,0,0,-9,0,0};


int moveList[gameLen] = {10, 14, 0, 0, 2, 0, -4, 0, 0, 0, 0, -6, 0,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 0, 0};

//{12, 14, 0, 0, 2, 0, -2, 0, 0, 0, -2, -8, 0,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 0, 0};

//{4, 2, 0, 0, 2, 0, 0, 0, 2, 2, 0, 0, 2,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 0, 0};

// {2,1,0,0,0,1,0,0,0,0,1,0,0,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0,0};

//{-4,0,0,0,0};



//



//void moveMag(int tog) {
//  if (tog == 0) {
//    magnet.write(70);
//  }
//  else {
//    magnet.write(145);
//  }
//}


void moveMag(int tog) {
  if (tog == 0) {
    magnet.write(magLow);
  }
  else {
    magnet.write(magHigh);
  }
}

void moveY(int hDist, int stepDel = 50) {
  //  float hDist = dist/2;
  if (hDist > 0) {
    digitalWrite(dirPinA, LOW);
    digitalWrite(dirPinB, LOW);
    for (int i = 0; i < hDist * squareMult; i++) {
      digitalWrite(stepPinA, HIGH);
      digitalWrite(stepPinB, HIGH);
      delayMicroseconds(stepDel);
      digitalWrite(stepPinA, LOW);
      digitalWrite(stepPinB, LOW);
      delayMicroseconds(stepDel);
    }
  } else {
    digitalWrite(dirPinA, HIGH);
    digitalWrite(dirPinB, HIGH);
    for (int i = 0; i < -hDist * squareMult; i++) {
      digitalWrite(stepPinA, HIGH);
      digitalWrite(stepPinB, HIGH);
      delayMicroseconds(stepDel);
      digitalWrite(stepPinA, LOW);
      digitalWrite(stepPinB, LOW);
      delayMicroseconds(stepDel);
    }
  }
}

void moveX(int hDist, int stepDel = 50) {
  //  float hDist = dist/2;
  if (hDist > 0) {
    digitalWrite(dirPinA, HIGH);
    digitalWrite(dirPinB, LOW);
    for (int i = 0; i < hDist * squareMult; i++) {
      digitalWrite(stepPinA, HIGH);
      digitalWrite(stepPinB, HIGH);
      delayMicroseconds(stepDel);
      digitalWrite(stepPinA, LOW);
      digitalWrite(stepPinB, LOW);
      delayMicroseconds(stepDel);
    }
  } else {
    digitalWrite(dirPinA, LOW);
    digitalWrite(dirPinB, HIGH);
    for (int i = 0; i < -hDist * squareMult; i++) {
      digitalWrite(stepPinA, HIGH);
      digitalWrite(stepPinB, HIGH);
      delayMicroseconds(stepDel);
      digitalWrite(stepPinA, LOW);
      digitalWrite(stepPinB, LOW);
      delayMicroseconds(stepDel);
    }
  }
}

void moveB(int hDist, int stepDel = 50) {
  //  float hDist = dist/2;
  if (hDist > 0) {
    digitalWrite(dirPinA, LOW); // Enables the motor to move in a particular direction
    // Makes 200 pulses for making one full cycle rotation
    for (int j = 0; j < 2; j++) {
      for (int i = 0; i < hDist * squareMult; i++) {
        digitalWrite(stepPinA, HIGH);
        delayMicroseconds(stepDel * 0.75);
        digitalWrite(stepPinA, LOW);
        delayMicroseconds(stepDel * 0.75);
      }
    }
  } else {
    digitalWrite(dirPinA, HIGH); // Enables the motor to move in a particular direction
    // Makes 200 pulses for making one full cycle rotation
    for (int j = 0; j < 2; j++) {
      for (int i = 0; i < -hDist * squareMult; i++) {
        digitalWrite(stepPinA, HIGH);
        delayMicroseconds(stepDel * 0.75);
        digitalWrite(stepPinA, LOW);
        delayMicroseconds(stepDel * 0.75);
      }
    }
  }
}

void moveA(int hDist, int stepDel = 50) {
  //  float hDist = dist/2;
  if (hDist > 0) {
    digitalWrite(dirPinB, LOW); // Enables the motor to move in a particular direction
    // Makes 200 pulses for making one full cycle rotation
    for (int j = 0; j < 2; j++) {
      for (int i = 0; i < hDist * squareMult; i++) {
        digitalWrite(stepPinB, HIGH);
        delayMicroseconds(stepDel * 0.75);
        digitalWrite(stepPinB, LOW);
        delayMicroseconds(stepDel * 0.75);
      }
    }
  } else {
    digitalWrite(dirPinB, HIGH); // Enables the motor to move in a particular direction
    // Makes 200 pulses for making one full cycle rotation
    for (int j = 0; j < 2; j++) {
      for (int i = 0; i < -hDist * squareMult; i++) {
        digitalWrite(stepPinB, HIGH);
        delayMicroseconds(stepDel * 0.75);
        digitalWrite(stepPinB, LOW);
        delayMicroseconds(stepDel * 0.75);
      }
    }
  }
}

int pos = 0;

int moveNum = 0;
int stepSpeed = 30;
int magTog = 0;

void loop() {
//  delay(1000);
  while (moveNum > gameLen) {
    Serial.println("Done!");
  }

  //  delay(1000);
  int modMoveNum = moveNum % 5;

  switch (modMoveNum)
  {
    case 0:
      Serial.print("X: ");
      Serial.println(moveList[moveNum] / 2);
      moveX(moveList[moveNum], stepSpeed);
      break;
    case 1:
      Serial.print("Y: ");
      Serial.println(moveList[moveNum] / 2);
      moveY(moveList[moveNum], stepSpeed);
      break;
    case 2:
      Serial.print("A: ");
      Serial.println(moveList[moveNum] / 2);
      moveA(moveList[moveNum], stepSpeed);
      break;
    case 3:
      Serial.print("B: ");
      Serial.println(moveList[moveNum] / 2);
      moveB(moveList[moveNum], stepSpeed);
      break;
    case 4:
      if (moveList[moveNum] / 2 == magTog) {
        break;
      }
      magTog = moveList[moveNum] / 2;
      //      delay(500);
      moveMag(magTog);
      Serial.print("Mag: ");
      Serial.println(magTog);

      if (magTog == 1) {
        stepSpeed = 75;
      }
      else {
        stepSpeed = 30;
      }
      delay(500);
      break;

  }
  Serial.println(moveNum);
  moveNum =  moveNum + 1;
  //  delay(100);






}










